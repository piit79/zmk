## app/boards/shields/lumberjack_pro/Kconfig.defconfig
```kconfig
# Copyright (c) 2021 The ZMK Contributors
# SPDX-License-Identifier: MIT

if SHIELD_LUMBERJACK_PRO

config ZMK_KEYBOARD_NAME
    default "lumberjack_pro"

if ZMK_RGB_UNDERGLOW

config WS2812_STRIP
    default y
endif

endif
```

## app/boards/shields/lumberjack_pro/Kconfig.shield
```kconfig
# Copyright (c) 2021 The ZMK Contributors
# SPDX-License-Identifier: MIT

config SHIELD_LUMBERJACK_PRO
    def_bool $(shields_list_contains,lumberjack_pro)
```

## app/boards/shields/southpaw75/Kconfig.defconfig
```kconfig
# Copyright (c) 2020 The ZMK Contributors
# SPDX-License-Identifier: MIT

if SHIELD_SOUTHPAW75

config ZMK_KEYBOARD_NAME
    default "Southpaw75"

endif
```

## app/boards/shields/southpaw75/Kconfig.shield
```kconfig
# Copyright (c) 2020 The ZMK Contributors
# SPDX-License-Identifier: MIT

config SHIELD_SOUTHPAW75
    def_bool $(shields_list_contains,southpaw75)
```

## app/boards/shields/unix60/Kconfig.defconfig
```kconfig
# Copyright (c) 2020 The ZMK Contributors
# SPDX-License-Identifier: MIT

if SHIELD_UNIX60

config ZMK_KEYBOARD_NAME
    default "Unix60"

endif
```
